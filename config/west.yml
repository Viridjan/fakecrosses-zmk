## config/west.yml
```yaml
manifest:
  remotes:
    - name: zmkfirmware
      url-base: https://github.com/zmkfirmware
    - name: urob
      url-base: https://github.com/urob/
  projects:
    - name: zmk
      remote: zmkfirmware
      revision: v0.3
      import: app/west.yml
    - name: zmk-helpers
      remote: urob
      revision: v0.3
    - name: gggw-zmk-keebs
      remote: Good-Great-Grand-Wonderful
      revision: zephyr-4.1
      import: config/west.yml
      
  self:
    path: config
```
